## layers/meta-balena-generic/conf/layer.conf
```bitbake
BBPATH .= ":${LAYERDIR}"

BBFILES += "${LAYERDIR}/recipes-*/*/*.bb \
            ${LAYERDIR}/recipes-*/*/*.bbappend"

BBFILE_COLLECTIONS += "balena-generic"
BBFILE_PATTERN_balena-generic := "^${LAYERDIR}/"
BBFILE_PRIORITY_balena-generic = "1337"

LAYERSERIES_COMPAT_balena-generic = "hardknott"
```

## layers/meta-balena-generic/conf/machine/generic-aarch64.conf
```bitbake
#@TYPE: Machine
#@NAME: Generic aarch64
#@DESCRIPTION: Machine configuration for Generic aarch64

require conf/machine/include/arm/arch-armv8a.inc
require conf/machine/include/kernel.inc

MACHINE_FEATURES += " efi"

MACHINE_EXTRA_RRECOMMENDS += "kernel-modules linux-firmware"

KERNEL_IMAGETYPE = "Image.gz"

SERIAL_CONSOLES = "115200;ttyS0"

DEFAULTTUNE ?= "aarch64"
SERIAL_CONSOLES = "115200;ttyAMA0"
```

## layers/meta-balena-generic/conf/machine/generic-amd64-av.conf
```bitbake
#@TYPE: Machine
#@NAME: Generic amd64 av
#@DESCRIPTION: Machine configuration for Generic amd64 av

include conf/machine/generic-amd64.conf
MACHINEOVERRIDES = "generic-amd64:${MACHINE}"

OS_KERNEL_CMDLINE:append = " modprobe.blacklist=nouveau,nvidiafb"
```

## layers/meta-balena-generic/conf/machine/generic-amd64-fs.conf
```bitbake
#@TYPE: Machine
#@NAME: Generic amd64 fs
#@DESCRIPTION: Machine configuration for Generic amd64 fs

include conf/machine/generic-amd64.conf
MACHINEOVERRIDES = "generic-amd64:${MACHINE}"
```

## layers/meta-balena-generic/conf/machine/generic-amd64.conf
```bitbake
#@TYPE: Machine
#@NAME: Generic amd64
#@DESCRIPTION: Machine configuration for Generic amd64

require conf/machine/include/kernel.inc

MACHINE_FEATURES += " efi raid tpm"

MACHINE_EXTRA_RRECOMMENDS += "kernel-modules linux-firmware"

KERNEL_IMAGETYPE ?= "bzImage"

OS_KERNEL_SECUREBOOT_CMDLINE:append = " intel_iommu=on amd_iommu=on"

SERIAL_CONSOLES ?= "115200;ttyS0"

DEFAULTTUNE ?= "core2-64"
require conf/machine/include/x86/tune-core2.inc
```

## layers/meta-balena-generic/conf/machine/generic-armv7.conf
```bitbake
#@TYPE: Machine
#@NAME: Generic armv7
#@DESCRIPTION: Machine configuration for Generic armv7

require conf/machine/include/arm/arch-armv7a.inc
require conf/machine/include/kernel.inc

MACHINE_FEATURES += " efi"

MACHINE_EXTRA_RRECOMMENDS += "kernel-modules linux-firmware"

KERNEL_IMAGETYPE = "zImage"

SERIAL_CONSOLES = "115200;ttyAMA0"
```

## layers/meta-balena-generic/conf/machine/generic-armv7ahf.conf
```bitbake
#@TYPE: Machine
#@NAME: Generic armv7hf
#@DESCRIPTION: Machine configuration for Generic armv7ahf

require conf/machine/include/arm/arch-armv7a.inc

DEFAULTTUNE ?= "armv7ahf"
SERIAL_CONSOLE = ""
```

## layers/meta-balena-generic/conf/machine/include/kernel.inc
```bitbake
PREFERRED_PROVIDER_virtual/kernel ?= "linux-yocto"
PREFERRED_VERSION_linux-yocto ?= "6.18%"

FIRMWARE_COMPRESSION = "1"
```

## layers/meta-balena-generic/conf/machine/kontron-come-xelx.conf
```bitbake
#@TYPE: Machine
#@NAME: Kontron COMe xELx
#@DESCRIPTION: Machine configuration for Kontron COMe xELx

include conf/machine/generic-amd64.conf
MACHINEOVERRIDES =. "generic-amd64:"
```

## layers/meta-balena-generic/conf/machine/studio-automatedx86-sb.conf
```bitbake
#@TYPE: Machine
#@NAME: Studio Automated X86 SB
#@DESCRIPTION: Machine configuration for Studio Automated X86 SB

include conf/machine/generic-amd64.conf
MACHINEOVERRIDES =. "generic-amd64:"
```

## layers/meta-resin-generic/conf/layer.conf
```bitbake
BBPATH .= ":${LAYERDIR}"

BBFILES += "${LAYERDIR}/recipes-*/*/*.bb \
            ${LAYERDIR}/recipes-*/*/*.bbappend"

BBFILE_COLLECTIONS += "resin-generic"
BBFILE_PATTERN_resin-generic := "^${LAYERDIR}/"
BBFILE_PRIORITY_resin-generic = "1337"
```
